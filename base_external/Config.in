## base_external/Config.in
```kconfig
# Config.in

# Inclure la configuration de chaque package dans le répertoire package/
source "$BR2_EXTERNAL_project_base_PATH/package/Config.in"
```

## base_external/package/Config.in
```kconfig
# package/Config.in

config BR2_PACKAGE_PACKAGE1
    bool "Package1"
    help
      Cette option permet d'ajouter Package1 à la construction Buildroot.
```
